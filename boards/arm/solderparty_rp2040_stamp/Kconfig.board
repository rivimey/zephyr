## boards/arm/solderparty_rp2040_stamp/Kconfig.board
```kconfig
# Copyright (c) 2022 Ruth Ivimey-Cook
# SPDX-License-Identifier: Apache-2.0

config BOARD_SOLDERPARTY_RP2040_STAMP
	bool "Solderparty RP2040 Stamp Board"
	depends on SOC_RP2040
```

## boards/arm/solderparty_rp2040_stamp/Kconfig.defconfig
```kconfig
# Copyright (c) 2022 Ruth Ivimey-Cook
# SPDX-License-Identifier: Apache-2.0

if BOARD_SOLDERPARTY_RP2040_STAMP

config BOARD
	default "solderparty_rp2040_stamp"

config RP2_FLASH_W25Q080
	default y

endif # BOARD_SOLDERPARTY_RP2040_STAMP
```

## drivers/adc/Kconfig.ads13xxxx
```kconfig
# ADS13XXXX ADC configuration options

# Copyright (c) 2022 Ruth Ivimey-Cook
# SPDX-License-Identifier: Apache-2.0

config ADC_ADS13XXXX
	bool "ADS13XXXX driver"
	depends on SPI
	help
	  Enable ADS13XXXX ADC driver for TI ADS130E08 ADCs.

	  The ADS130E08 is an 8 channel 16-bit Delta-Sigma A/D converter
	  with SPI interface. The ADS131E08/E06/E04 are similar but 24bit.

if ADC_ADS13XXXX

config ADC_ADS13XXXX_ACQ_THREAD_STACK_SIZE
	int "Stack size for the ADC data acquisition thread"
	default 512
	help
	  Size of the stack used for the internal data acquisition thread.

config ADC_ADS13XXXX_ACQ_THREAD_PRIO
	int "Priority for the ADC data acquisition thread"
	default 0
	help
	  Priority level for the internal ADC data acquisition thread.

endif # ADC_ADS13XXXX
```

## soc/arm/rpi_pico/rp2/Kconfig.soc
```kconfig
# Raspberry Pi RP2XXX MCU line

# Copyright (c) 2021 Nordic Semiconductor ASA
# Copyright (c) 2021 Yonatan Schachter
# Copyright (c) 2022 Ruth Ivimey-Cook
#
# SPDX-License-Identifier: Apache-2.0

choice
	prompt "RP2xxx MCU Selection"
	depends on SOC_SERIES_RP2XXX

config SOC_RP2040
	bool "Raspberry Pi RP2040"

endchoice

# These options are unlikely to be useful for any other SOC, because
# they relate to SOC-specific assembler files.
choice RP2_BOOT_FLASH_DEVICE
	prompt "RP2xxx Boot Device Selection"
	depends on SOC_RP2040

config RP2_FLASH_W25Q080
	bool "Winbond W25Q080 (& compatible) Flash over QSPI"
	help
		Enables QSPI boot code that understands the Winbond W25Q080 and
		W25Q16JV, Adesto AT25SF081, and Cypress S25FL132K0 Flash devices.
		Should be defined in the board definition.

config RP2_FLASH_IS25LP080
	bool "ISSI IS25LP080 Flash over QSPI"
	help
		Enables QSPI boot code that understands ISSI IS25LP080D Flash
		devices. Code is a variant of the W25Q080 boot code.
		Should be defined in the board definition.

config RP2_FLASH_W25X10CL
	bool "Winbond W25X10CL Flash over QSPI"
	help
		Enables QSPI boot code that understands the Winbond W25X10CL
		Flash device.
		Should be defined in the board definition.

config RP2_FLASH_AT25SF128A
	bool "Adesto AT25SF128A Flash over QSPI"
	help
		Enables QSPI boot code that understands the Adesto AT25SF128A
		Flash device. Code is a variant of the W25Q080 boot code.
		Should be defined in the board definition.

config RP2_FLASH_GENERIC_03H
	bool "Boot from generic SPI Flash"
	help
		Enables SPI boot code that understands any Flash device that
		responds to an SPI Serial Read (03h) command. This will be
		about 3x slower than when using QSPI.
		Should be defined in the board definition.

endchoice
```
